/dts-v1/;
/plugin/;

#include <dt-bindings/gpio/gpio.h>
#include "i2c-buses.dtsi"

/ {
	compatible = "brcm,bcm2835";

	fragment@0 {
		target = <&i2c1>;
		__overlay__ {
			#address-cells = <1>;
			#size-cells = <0>;           
			status = "okay";

			vi5300: vi5300@6c {
				status = "okay";
				compatible = "evisionics,vi5300";
				reg = <0x6c>;
				irq-gpios = <&gpio 24 GPIO_ACTIVE_LOW>;
				xshut-gpios = <&gpio 23 GPIO_ACTIVE_LOW>;
			};
		};
	};
};